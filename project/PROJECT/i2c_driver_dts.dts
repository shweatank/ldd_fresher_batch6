/dts-v1/;
/plugin/;

/ {
	compatible = "brcm,bcm2711";

	fragment@0 {
		target = <&i2c1>;

		__overlay__ {
			status = "okay";

			oled@3c {
				compatible = "siddarth,oled-ssd1306";
				reg = <0x3c>;
			};
		};
	};
};
