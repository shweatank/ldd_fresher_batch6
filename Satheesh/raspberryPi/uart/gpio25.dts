/dts-v1/;
/plugin/;

/ {
    compatible = "brcm,bcm2711";

    fragment@0 {
        target-path = "/";

        __overlay__ {
            my_led {
                compatible = "satheesh,gpio25";
                gpios = <&gpio 25 0>;
                status = "okay";
            };
        };
    };
};

