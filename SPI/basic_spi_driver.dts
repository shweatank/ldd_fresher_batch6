/dts-v1/;
/plugin/;

&spi0 {
    status = "okay";

    ili9225@0 {
        compatible = "ilitek,ili9225";
        reg = <0>;

        spi-max-frequency = <10000000>;

        dc-gpios = <&gpio 25 0>;
        reset-gpios = <&gpio 24 0>;
    };
};
