
/dts-v1/;
/plugin/;

/ {
    compatible = "brcm,bcm2711";

    fragment@0 {
        target-path = "/";

        __overlay__ {

            #address-cells = <2>;
            #size-cells = <2>;

            uart_demo@fe201000 {
                compatible = "vaishnavi,uart-demo";

                reg = <0x0 0xfe201000 0x0 0x1000>;
            };
        };
    };
};

