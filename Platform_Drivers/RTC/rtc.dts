/dts-v1/;
/plugin/;

/ {
    compatible = "brcm,bcm2711";

    fragment@0 {
        target-path = "/";

        __overlay__ {

            dummy_rtc {
                compatible = "mycompany,dummy-rtc";
                status = "okay";
            };
        };
    };
};
